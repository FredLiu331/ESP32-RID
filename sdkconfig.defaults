## sdkconfig.defaults
```kconfig
CONFIG_ESPTOOLPY_FLASHSIZE_32MB=y
CONFIG_PARTITION_TABLE_CUSTOM=y
CONFIG_PARTITION_TABLE_CUSTOM_FILENAME="partitions.csv"
CONFIG_BT_ENABLED=y
CONFIG_BT_NIMBLE_ENABLED=y
CONFIG_BT_NIMBLE_ROLE_BROADCASTER=y
CONFIG_BT_NIMBLE_50_FEATURE_SUPPORT=y
CONFIG_BT_NIMBLE_EXT_ADV=y
CONFIG_BT_NIMBLE_MAX_EXT_ADV_INSTANCES=2
CONFIG_BT_NIMBLE_EXT_ADV_MAX_SIZE=158
CONFIG_BT_LE_EXT_ADV_RESERVED_MEMORY_COUNT=2
# CONFIG_BT_NIMBLE_LOG_LEVEL_INFO is not set
CONFIG_BT_NIMBLE_LOG_LEVEL_WARNING=y
CONFIG_ESP_CONSOLE_UART_DEFAULT=y
CONFIG_ESP_TASK_WDT_EN=y
CONFIG_ESP_TASK_WDT_INIT=y
# CONFIG_COMPILER_CXX_EXCEPTIONS is not set
```

## test_apps/integration/sdkconfig.defaults
```kconfig
CONFIG_BT_ENABLED=y
CONFIG_BT_NIMBLE_ENABLED=y
CONFIG_BT_NIMBLE_ROLE_BROADCASTER=y
CONFIG_BT_NIMBLE_50_FEATURE_SUPPORT=y
CONFIG_BT_NIMBLE_EXT_ADV=y
CONFIG_BT_NIMBLE_MAX_EXT_ADV_INSTANCES=2
CONFIG_BT_NIMBLE_EXT_ADV_MAX_SIZE=158
CONFIG_BT_LE_EXT_ADV_RESERVED_MEMORY_COUNT=2
CONFIG_ESP_WIFI_ENABLED=y
CONFIG_PARTITION_TABLE_SINGLE_APP_LARGE=y
CONFIG_ESP_MAIN_TASK_STACK_SIZE=32768
CONFIG_ESP_TASK_WDT_INIT=n
CONFIG_UNITY_ENABLE_64BIT=y
```

## test_apps/logic/sdkconfig.defaults
```kconfig
# The Unity UART menu busy-waits while idle, so it cannot coexist with IDLE task monitoring.
CONFIG_ESP_TASK_WDT_INIT=n
CONFIG_UNITY_ENABLE_64BIT=y
CONFIG_BT_ENABLED=y
CONFIG_BT_NIMBLE_ENABLED=y
CONFIG_BT_NIMBLE_ROLE_BROADCASTER=y
CONFIG_BT_NIMBLE_50_FEATURE_SUPPORT=y
CONFIG_BT_NIMBLE_EXT_ADV=y
CONFIG_BT_NIMBLE_MAX_EXT_ADV_INSTANCES=2
CONFIG_BT_NIMBLE_EXT_ADV_MAX_SIZE=158
CONFIG_BT_LE_EXT_ADV_RESERVED_MEMORY_COUNT=2
CONFIG_ESP_WIFI_ENABLED=y
```

## test_apps/radio_probe/sdkconfig.defaults
```kconfig
CONFIG_BT_ENABLED=y
CONFIG_BT_NIMBLE_ENABLED=y
CONFIG_BT_NIMBLE_50_FEATURE_SUPPORT=y
CONFIG_BT_NIMBLE_EXT_ADV=y
CONFIG_BT_NIMBLE_MAX_EXT_ADV_INSTANCES=3
CONFIG_PARTITION_TABLE_SINGLE_APP_LARGE=y
CONFIG_ESP_CONSOLE_UART_DEFAULT=y
# CONFIG_COMPILER_CXX_EXCEPTIONS is not set
```
